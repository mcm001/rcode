#include <avr/io.h>
#include <avr/interrupt.h>

const unsigned char buzz[] PROGMEM = {
228,33,165,146,84,185,84,153,125,111,170,68,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224,
};

int sounddata_length=0;
volatile uint16_t sample;
byte lastSample;

ISR(TIM0_OVF_vect)
{
  if(sample >= sounddata_length) {
    sample = 0;
  }

  static volatile uint16_t sampleCounter = 0;
  static volatile uint16_t outputCounter = 0;
  static volatile uint16_t freqcounter = 0;
  sampleCounter++;
  freqcounter++;


  if(sampleCounter >= 400) { // runs at 8.1khz
      //sample flash memory
      lastSample = pgm_read_byte(&buzz[sample]); //buzz[sample];
      sample++;
      
      sampleCounter = 0; //reset counter to 0
  }

  if(freqcounter < (lastSample / 5) )
    {
       PORTB |= digitalPinToBitMask(0); //turn on pin
    }
  else
    {
       PORTB &= ~digitalPinToBitMask(0); //turn off pin
    }

  if(freqcounter >= (256 / 5) ) { freqcounter = 0; }
  
  TCNT0 = 65535; // overflow reset 
}

int
main(void)
{

        /* setup */
        DDRB = 0b00000001; // set speaker pin as OUTPUT
//        pinMode(8, OUTPUT);
        TCCR0B |= (1<<CS00); // no prescaling
        TIMSK0 |= _BV(TOIE0); // enable Timer Overflow interrupt
        sei(); // enable global interrupts

        lastSample = pgm_read_byte(&buzz[0]);

        /* loop */
        while (1);
}
